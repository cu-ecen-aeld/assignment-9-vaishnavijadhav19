## base_external/package/aesd-char-driver/Config.in
```kconfig
config BR2_PACKAGE_AESD_CHAR_DRIVER
    bool "aesd-char-driver"
    help
      installs aesd char driver and init scrips from Assignment 3 repository.
```

## base_external/package/ldd/Config.in
```kconfig
config BR2_PACKAGE_LDD
    bool "ldd"
    help
      Linux Device Driver modules (misc-modules and scull)
      built from Assignment 7 repository.
```
